## build/conf/bblayers.conf
```bitbake
# POKY_BBLAYERS_CONF_VERSION is increased each time build/conf/bblayers.conf
# changes incompatibly
POKY_BBLAYERS_CONF_VERSION = "2"

BBPATH = "${TOPDIR}"
BBFILES ?= ""

PROJECT_DIR="${@os.path.abspath(os.path.join("${TOPDIR}", os.pardir))}"

BBLAYERS ?= " \
  ${PROJECT_DIR}/poky/meta \
  ${PROJECT_DIR}/poky/meta-poky \
  ${PROJECT_DIR}/poky/meta-yocto-bsp \
  ${PROJECT_DIR}/meta-bazel \
  "
```
